## dualshock4/Kconfig
```kconfig
menu "DualShock4 Configuration"

    config DS4_ENABLE
        bool "Enable DS4"
        select BT_ENABLED
        select BT_BLUEDROID_ENABLED
        select BLUEDROID_PINNED_TO_CORE_0
        select BT_BREDR_ENABLED
        select BT_CLASSIC_ENABLED
        select BT_CONTROLLER_ENABLED
        select BLUEPAD32_PLATFORM_CUSTOM


    choice DS4_MODE
        prompt "DualShock4 operation mode"
        depends on DS4_ENABLE
        default DS4_MODE_EVENT
        help
            Will you only be using polling or
            do you want to also attach events to buttons
    
    config DS4_MODE_EVENT
        bool "Event-based mode"

    config DS4_MODE_ONLY_POLLING
        bool "Just polling"
        
    endchoice


    choice DS4_BT_MAC_MODE
        prompt "Bluetooth MAC Address Mode"
        depends on DS4_ENABLE
        default DS4_BT_MAC_DEFAULT

    config DS4_BT_MAC_DEFAULT
        bool "Use default ESP32 Bluetooth MAC"

    config DS4_BT_MAC_CUSTOM
        bool "Use custom Bluetooth MAC"

    endchoice

    config DS4_BT_CUSTOM_MAC_STRING
        string "Custom Bluetooth MAC Address"
        depends on DS4_BT_MAC_CUSTOM
        default "AA:BB:CC:DD:EE:FF"
        help
            Enter MAC in format:
            XX:XX:XX:XX:XX:XX
    
    
    choice DS4_CONTROLLER_CONNECT_MODE
        prompt "Controller connect mode"
        depends on DS4_ENABLE
        default DS4_AUTOCONNECT_MODE

    config DS4_AUTOCONNECT_MODE
        bool "Autoconnect to any discovered device"

    config DS4_CONNECT_TO_SPECIFIC_MAC
        bool "Connect only to a specific MAC address of the controller"

    endchoice

    config DS4_CONTROLLER_MAC_STRING
        string "MAC address of your controller"
        depends on DS4_CONNECT_TO_SPECIFIC_MAC
        default "XX:XX:XX:XX:XX:XX"
        help
            Enter MAC in format:
            XX:XX:XX:XX:XX:XX
    

endmenu
```

## dualshock4/examples/events/sdkconfig.defaults
```kconfig
# =========================
# DualShock4 Library
# Required ESP-IDF Settings
# =========================

# Enable DS4 component
CONFIG_DS4_ENABLE=y
CONFIG_DS4_MODE_EVENT=y

# =========================
# Bluetooth
# =========================

CONFIG_BT_ENABLED=y
CONFIG_BT_CONTROLLER_ENABLED=y
CONFIG_BT_BLUEDROID_ENABLED=y
CONFIG_BT_CLASSIC_ENABLED=y
CONFIG_BT_BREDR_ENABLED=y

# Bluedroid must run on Core 0
CONFIG_BLUEDROID_PINNED_TO_CORE_0=y

# =========================
# Bluepad32
# =========================

# Required platform
CONFIG_BLUEPAD32_PLATFORM_CUSTOM=y

# GAP security must be disabled
# (leave unset)
# CONFIG_BLUEPAD32_GAP_SECURITY is not set

# DS4 library uses only one controller
CONFIG_BLUEPAD32_MAX_DEVICES=1

# Allowlist size
CONFIG_BLUEPAD32_MAX_ALLOWLIST=1
```
